#include <Arduino.h>
#include <stdarg.h>
#include "lcd.h"
#include "tch.h"


Pio *Port_RST = g_APinDescription[LCD_RST].pPort;
Pio *Port_CS  = g_APinDescription[LCD_CS].pPort;
Pio *Port_RS  = g_APinDescription[LCD_RS].pPort;
Pio *Port_WR  = g_APinDescription[LCD_WR].pPort;
Pio *Port_RD  = g_APinDescription[LCD_RD].pPort;
Pio *Port_D0  = g_APinDescription[LCD_D0].pPort;
Pio *Port_D1  = g_APinDescription[LCD_D1].pPort;
Pio *Port_D2  = g_APinDescription[LCD_D2].pPort;
Pio *Port_D3  = g_APinDescription[LCD_D3].pPort;
Pio *Port_D4  = g_APinDescription[LCD_D4].pPort;
Pio *Port_D5  = g_APinDescription[LCD_D5].pPort;
Pio *Port_D6  = g_APinDescription[LCD_D6].pPort;
Pio *Port_D7  = g_APinDescription[LCD_D7].pPort;

unsigned int Mask_RST = g_APinDescription[LCD_RST].ulPin;
unsigned int Mask_CS  = g_APinDescription[LCD_CS].ulPin;
unsigned int Mask_RS  = g_APinDescription[LCD_RS].ulPin;
unsigned int Mask_WR  = g_APinDescription[LCD_WR].ulPin;
unsigned int Mask_RD  = g_APinDescription[LCD_RD].ulPin;
unsigned int Mask_D0  = g_APinDescription[LCD_D0].ulPin;
unsigned int Mask_D1  = g_APinDescription[LCD_D1].ulPin;
unsigned int Mask_D2  = g_APinDescription[LCD_D2].ulPin;
unsigned int Mask_D3  = g_APinDescription[LCD_D3].ulPin;
unsigned int Mask_D4  = g_APinDescription[LCD_D4].ulPin;
unsigned int Mask_D5  = g_APinDescription[LCD_D5].ulPin;
unsigned int Mask_D6  = g_APinDescription[LCD_D6].ulPin;
unsigned int Mask_D7  = g_APinDescription[LCD_D7].ulPin;

int back_color = WHITE;
int text_color = BLACK;
int keisen_color = GRAY;
int graph_color  = RED;

int lcd_x;                  // 0・ｽE・ｽ`25
int lcd_y;                  // 0・ｽE・ｽ`14
int lcd_noofline = 15;            // ・ｽE・ｽP・ｽE・ｽ・ｽE・ｽﾊの行・ｽE・ｽ・ｽE・ｽ
char lcd_text_buf[15][26];

extern const uint8_t KanjiFont12b[][18];


/********************************************************************************/
/*    lcd_printf                                */
/********************************************************************************/
void lcd_printf(const char *fmt, ...)
{
  char buf[200];
  va_list ap;
  
  va_start(ap, fmt);
  vsprintf(buf, fmt, ap);
  va_end(ap);
  lcd_puts(buf);
}
/********************************************************************************/
/*    lcd_puts                                */
/********************************************************************************/
void lcd_puts(const char *str)
{
  while(*str)
    lcd_putc(*str++);
}
/********************************************************************************/
/*    lcd_putc                                */
/********************************************************************************/
void lcd_scroll()
{
  int i;
  
  memmove(lcd_text_buf, lcd_text_buf[1], 26*(lcd_noofline-1));
  memset(lcd_text_buf[lcd_noofline-1], ' ', 26);
  lcd_x = lcd_y = 0;
  for(i=0; i<26*(lcd_noofline-1); i++){
    lcd_putc(((char*)lcd_text_buf)[i]);
  }
  lcd_clearA(0, 16*(lcd_noofline-1), 319, 16*lcd_noofline-1, back_color); // ・ｽﾅ会ｿｽ・ｽs・ｽN・ｽ・ｽ・ｽA
}

void lcd_nl()
{
  lcd_x = 0;
  if(++lcd_y >= lcd_noofline){
    lcd_scroll();           // ・ｽX・ｽN・ｽ・ｽ・ｽ[・ｽ・ｽ
    lcd_x = 0;
    lcd_y = lcd_noofline - 1;
  }
}

void lcd_putc(char c)
{
  if(c=='\n'){
    lcd_nl();             // new line
    return;
  }
  if(lcd_x > 25){
    lcd_nl();
  }
  lcd_disp_char_x1(lcd_x*12, lcd_y*16, c);
  lcd_text_buf[lcd_y][lcd_x] = c;
  ++lcd_x;
}
/********************************************************************************/
/*    lcd_disp_str_x1                             */
/*    ・ｽL・ｽ・ｽ・ｽ・ｽ・ｽ[・ｽl・ｽ・ｽ 10x14 ・ｽ・ｽ・ｽ・ｽ・ｽ・ｽ・ｽ・ｽ・ｽﾂゑｿｽ・ｽ・ｽ 12x16 ・ｽh・ｽb・ｽg・ｽﾌ包ｿｽ・ｽ・ｽ・ｽ・ｽ`・ｽ・ｽ       */
/*    text_color, back_color ・ｽﾌ色・ｽw・ｽ・ｽﾉ従・ｽ・ｽ                  */
/********************************************************************************/
void lcd_disp_str_x1(int x, int y, const char *str)
{
  while(*str){
    lcd_disp_char_x1(x, y, *str);
    ++str;
    x += 12;
  }
}

void lcd_disp_str_x2(int x, int y, const char *str)
{
  while(*str){
    lcd_disp_char_x2(x, y, *str);
    ++str;
    x += 24;
  }
}

void lcd_cdisp_str_x1(int y, const char *str)
{
    int x;
    
    x = (320-strlen(str)*12)/2;
    if(x<0)
        x = 0;
    lcd_disp_str_x1(x, y, str);
}

void lcd_cdisp_str_x2(int y, const char *str)
{
    int x;
    
    x = (320-strlen(str)*24)/2;
    if(x<0)
        x = 0;
    lcd_disp_str_x2(x, y, str);
}
/********************************************************************************/
/*    lcd_disp_char_x1                            */
/*    12x16 ・ｽh・ｽb・ｽg・ｽﾌ包ｿｽ・ｽ・ｽ・ｽ・ｽ`・ｽ・ｽ                        */
/*    text_color, back_color ・ｽﾌ色・ｽw・ｽ・ｽﾉ従・ｽ・ｽ                  */
/*    return 0:success, -1:error                        */
/********************************************************************************/
int lcd_disp_char_x1(int x, int y, char c)
{
  int i, k, x2, y2, cg /*, color*/;
  
  x2 = x + (12-1);
  y2 = y + (16-1);
  if(lcd_area_set(x, y, x2, y2)<0){
    return -1;            // error
  }
  lcd_write_cmd(MemoryWrite);
  for(i=0; i<16; i++){        // 16 ・ｽs・ｽ・ｽ・ｽ・ｽ・ｽﾔに擾ｿｽ・ｽ・ｽ・ｽ・ｽ・ｽ・ｽ
    cg = font[(unsigned char)c][i]; // ・ｽL・ｽ・ｽ・ｽ・ｽ・ｽ[・ｽl・ｽP・ｽs
    for(k=0; k<12; k++){
      if(cg & 1)
        lcd_write_color(text_color);
      else
        lcd_write_color(back_color);
      cg >>= 1;
    }
  }
  return 0;             // success
}

int lcd_disp_char_x2(int x, int y, char c)
{
  int i, k, m, x2, y2, cg /*, color*/;
  
  x2 = x + (24-1);
  y2 = y + (32-1);
  if(lcd_area_set(x, y, x2, y2)<0){
    return -1;            // error
  }
  lcd_write_cmd(MemoryWrite);
  for(i=0; i<16; i++){        // 16 ・ｽs・ｽ・ｽ・ｽ・ｽ・ｽﾔに擾ｿｽ・ｽ・ｽ・ｽ・ｽ・ｽ・ｽ
    for(m=0; m<2; m++){
      cg = font[(unsigned char)c][i]; // ・ｽL・ｽ・ｽ・ｽ・ｽ・ｽ[・ｽl・ｽP・ｽs
      for(k=0; k<12; k++){
        if(cg & 1){
          lcd_write_color(text_color);
          lcd_write_color(text_color);
        }
        else{
          lcd_write_color(back_color);
          lcd_write_color(back_color);
        }
        cg >>= 1;
      }
    }
  }
  return 0;             // success
}


//	2 バイトコードの表示、c:キャラゼネコード
int sjis_disp_char_x1(int x, int y, int c)
{
	int i, j, cg, bit /*, color*/;
	
//	x2 = x + (12-1);
//	y2 = y + (16-1);
	lcd_area_square(x, y, 12, 16);
	lcd_write_cmd(MemoryWrite);

//	LCD_ALL_H;
//	LCD_CS_L;
//	LCD_DC_H;                           // data
	bit = 0x80;
	for(i=0; i<12*16; i++){				// 16 行を順番に処理する
		j = (i-24)/8;
		cg = KanjiFont12b[c][j];		// キャラゼネ１行
		if((cg & bit) && (i>=12*2 && i<12*14)){
			lcd_write_color(text_color);
//			while(SPI2STATbits.SPITBE==0)
//				;
//			SPI2BUF = text_color>>8;
//			while(SPI2STATbits.SPITBE==0)
//				;
//			SPI2BUF = text_color;
		}
		else{
			lcd_write_color(back_color);
//			while(SPI2STATbits.SPITBE==0)
//				;
//			SPI2BUF = back_color>>8;
//			while(SPI2STATbits.SPITBE==0)
//				;
//			SPI2BUF = back_color;
		}
		bit >>= 1;
		if(bit==0)
			bit = 0x80;
	}
//	while(SPI2STATbits.SPIBUSY)
//		;
//	LCD_ALL_H;
	return 0;							// success
}

int sjis_disp_char_reverse_x1(int x, int y, int c)
{
	int i, j, cg, bit /*, color*/;
	
//	x2 = x + (12-1);
//	y2 = y + (16-1);
	lcd_area_square(x, y, 12, 16);
	lcd_write_cmd(MemoryWrite);

//	LCD_ALL_H;
//	LCD_CS_L;
//	LCD_DC_H;                           // data
	bit = 0x01;
	for(i=0; i<12*16; i++){				// 16 行を順番に処理する
		j = (i-24)/8;
		cg = KanjiFont12b[c][17-j];		// キャラゼネ１行
		if((cg & bit) && (i>=12*2 && i<12*14)){
			lcd_write_color(text_color);
//			while(SPI2STATbits.SPITBE==0)
//				;
//			SPI2BUF = text_color>>8;
//			while(SPI2STATbits.SPITBE==0)
//				;
//			SPI2BUF = text_color;
		}
		else{
			lcd_write_color(back_color);
//			while(SPI2STATbits.SPITBE==0)
//				;
//			SPI2BUF = back_color>>8;
//			while(SPI2STATbits.SPITBE==0)
//				;
//			SPI2BUF = back_color;
		}
		bit <<= 1;
		if((bit&0xff)==0)
			bit = 0x01;
	}
//	while(SPI2STATbits.SPIBUSY)
//		;
//	LCD_ALL_H;
	return 0;							// success
}
/********************************************************************************/
/*    lcd_area_set                              */
/*    ・ｽl・ｽp・ｽﾌ搾ｿｽ・ｽW・ｽ・ｽ lcd ・ｽﾉセ・ｽb・ｽg・ｽ・ｽ・ｽ・ｽ                      */
/********************************************************************************/
int lcd_area_set(int x1, int y1, int x2, int y2)
{
  if(x1<0 || x1>=320 || x2<0 || x2>=320 || y1<0 || y1>=240 || y2<0 || y2>=240 || x1>x2 || y1>y2)
    return -1;            // error
  lcd_write_cmd(ColumnAddressSet);
  lcd_write_data(x1>>8);        // start ・ｽ・ｽ・ｽ
  lcd_write_data(x1);         // start ・ｽ・ｽ・ｽ・ｽ
  lcd_write_data(x2>>8);        // end ・ｽ・ｽ・ｽ
  lcd_write_data(x2);         // end ・ｽ・ｽ・ｽ・ｽ
  
  lcd_write_cmd(PageAddressSet);
  lcd_write_data(y1>>8);        // start ・ｽ・ｽ・ｽ
  lcd_write_data(y1);         // start ・ｽ・ｽ・ｽ・ｽ
  lcd_write_data(y2>>8);        // end ・ｽ・ｽ・ｽ
  lcd_write_data(y2);         // end ・ｽ・ｽ・ｽ・ｽ
  return 0;             // success
}

int lcd_area_square(int x, int y, int w, int h)
{
	return lcd_area_set(x,y, x+w-1, y+h-1);
}
/********************************************************************************/
/*    lcd_clear                               */
/*    ・ｽw・ｽ・ｽﾍ囲ゑｿｽh・ｽ・ｽﾂぶゑｿｽ                          */
/********************************************************************************/
int lcd_clearA(int x1, int y1, int x2, int y2, int color)
{
  int i;
  
  lcd_area_set(x1, y1, x2, y2);
  lcd_write_cmd(MemoryWrite);
  for(i=0; i<(x2-x1+1)*(y2-y1+1); i++)
    lcd_write_color(color);
  return 0;             // success
}

void lcd_clear_square(int x, int y, int w, int h, int color)
{
	lcd_clearA(x, y, x+w-1, y+h-1, color);
}

//    ・ｽS・ｽ・ｽﾊ塗・ｽ・ｽﾂぶゑｿｽ

int lcd_clear(int color)
{
  lcd_x = lcd_y = 0;
  memset(lcd_text_buf, ' ', sizeof(lcd_text_buf));
  return lcd_clearA(0, 0, 319, 239, color);
}

void lcd_write_square(int x, int y, int w, int h, const short *pat)
{
  int i;
  
  lcd_area_set(x, y, x+w-1, y+h-1);
  lcd_write_cmd(MemoryWrite);
  for(i=0; i<w*h; i++)
    lcd_write_color(pat[i]);
}

void lcd_clear1_square(int x, int y, int w, int h, char color)
{
	int i;
	
	lcd_area_set(x, y, x+w-1, y+h-1);
	lcd_write_cmd(MemoryWrite);

	if(color&0x01) Port_D0->PIO_SODR=Mask_D0; else Port_D0->PIO_CODR=Mask_D0;
	if(color&0x02) Port_D1->PIO_SODR=Mask_D1; else Port_D1->PIO_CODR=Mask_D1;
	if(color&0x04) Port_D2->PIO_SODR=Mask_D2; else Port_D2->PIO_CODR=Mask_D2;
	if(color&0x08) Port_D3->PIO_SODR=Mask_D3; else Port_D3->PIO_CODR=Mask_D3;
	if(color&0x10) Port_D4->PIO_SODR=Mask_D4; else Port_D4->PIO_CODR=Mask_D4;
	if(color&0x20) Port_D5->PIO_SODR=Mask_D5; else Port_D5->PIO_CODR=Mask_D5;
	if(color&0x40) Port_D6->PIO_SODR=Mask_D6; else Port_D6->PIO_CODR=Mask_D6;
	if(color&0x80) Port_D7->PIO_SODR=Mask_D7; else Port_D7->PIO_CODR=Mask_D7;

	Port_RS->PIO_SODR = Mask_RS;
	Port_CS->PIO_CODR = Mask_CS;
	for(i=0; i<w*h*2; i++){
		Port_WR->PIO_CODR = Mask_WR;
		Port_WR->PIO_SODR = Mask_WR;
	}
	Port_CS->PIO_SODR = Mask_CS;
}

void lcd_clear1(char color)
{
	lcd_clear1_square(0,0, 320,240, color);
}

void lcd_clear_B()
{
	lcd_clear1(0);
}

void lcd_clear_W()
{
	lcd_clear1(0xff);
}
/********************************************************************************/
/*    lcd_init                                */
/********************************************************************************/
void lcd_init()
{
  int i;
  
  pinMode(LCD_RST, OUTPUT);
  pinMode(LCD_RD,  OUTPUT);
  pinMode(LCD_WR,  OUTPUT);
  pinMode(LCD_CS,  OUTPUT);
  pinMode(LCD_RS,  OUTPUT);
  pinMode(LCD_D0,  OUTPUT);
  pinMode(LCD_D1,  OUTPUT);
  pinMode(LCD_D2,  OUTPUT);
  pinMode(LCD_D3,  OUTPUT);
  pinMode(LCD_D4,  OUTPUT);
  pinMode(LCD_D5,  OUTPUT);
  pinMode(LCD_D6,  OUTPUT);
  pinMode(LCD_D7,  OUTPUT);
  
	Port_RST->PIO_SODR = Mask_RST;
	Port_RD->PIO_SODR = Mask_RD;
	Port_WR->PIO_SODR = Mask_WR;
	Port_CS->PIO_SODR = Mask_CS;

  delay(25);
  lcd_write_cmd(0x01);        // Software Reset
  delay(25);
  
  lcd_write_cmd(0x11);        // Sleep Out
  delay(25);
  
  lcd_write_cmd(0x36);        // Memory Access Control
//  lcd_write_data(0byx100000);     // y: Row Address Order x: Column Address Order
  lcd_write_data(0b00100000);     // MY=0, MX=0, MV=1, ML=0, BGR=0, MH=0
//  lcd_write_data(0b11100000);     // MY=0, MX=0, MV=1, ML=0, BGR=0, MH=0
  
  lcd_write_cmd(0x3a);        // Pixel Format Set
  lcd_write_data(0x55);       // 16bit/pixel
  
  lcd_write_cmd(0x53);        // Write CTRL Display
  lcd_write_data(0b00100100);     // BCTRL=1, DD=0, BL=1
  
  lcd_write_cmd(0x29);        // Display ON
}
/********************************************************************************/
/*    fatal                                 */
/********************************************************************************/
void fatal(const char *msg1, const char *msg2, const char *msg3)
{
//  lcd_clear(WHITE);
  back_color = RED;
  text_color = WHITE;
  lcd_disp_str_x2(28, 55, "FATAL error");
  back_color = WHITE;
  text_color = BLACK;
    if(msg1)
      lcd_disp_str_x1(0, 140, msg1);
    if(msg2)
      lcd_disp_str_x1(0, 160, msg2);
    if(msg3)
      lcd_disp_str_x1(0, 180, msg3);
  for(;;)
    ;
}
/********************************************************************************/
/*    message                                 */
/********************************************************************************/

int message(const char *fmt, ...)
{
  int x, y;
  char buf[200];
  va_list ap;
  
  lcd_clear(WHITE);
  back_color = BRUE;
  text_color = WHITE;
  lcd_cdisp_str_x2(55, "Message");
  back_color = WHITE;
  text_color = BLACK;

  lcd_y = 8;
  va_start(ap, fmt);
  vsprintf(buf, fmt, ap);
  va_end(ap);
  lcd_puts(buf);
//  sw_updown();
  mouse_updown(&x, &y);
    return 0;
}
/********************************************************************************/
/*		lcd_read_data															*/
/********************************************************************************/
int lcd_read_data()
{
	int tmp;
	
//	LCD_RD_C;							// RD clear
//	LCD_RD_C;							// RD clear
//	tmp = LCD_INPUT;					// read data
//	LCD_RD_S;							// RD set
	
//	digitalWrite(LCD_RD, LOW);
	Port_RD->PIO_CODR = Mask_RD;		// RD LOW
	
	tmp = 0;
	if(digitalRead(LCD_D0)==HIGH) tmp += 0x01;
	if(digitalRead(LCD_D1)==HIGH) tmp += 0x02;
	if(digitalRead(LCD_D2)==HIGH) tmp += 0x04;
	if(digitalRead(LCD_D3)==HIGH) tmp += 0x08;
	if(digitalRead(LCD_D4)==HIGH) tmp += 0x10;
	if(digitalRead(LCD_D5)==HIGH) tmp += 0x20;
	if(digitalRead(LCD_D6)==HIGH) tmp += 0x40;
	if(digitalRead(LCD_D7)==HIGH) tmp += 0x80;
	
//	digitalWrite(LCD_RD, HIGH);
	Port_RD->PIO_SODR = Mask_RD;		// RD HIGH
	
	return tmp;
}
/********************************************************************************/
/*    lcd_read_mem                              */
/********************************************************************************/
void lcd_read_mem(int x1, int y1, int x2, int y2, short *buf)
{
  int i, c1, c2, c3;
  
  lcd_area_set(x1, y1, x2, y2);
  lcd_write_cmd(MemoryRead);

  pinMode(LCD_D0,  INPUT);
  pinMode(LCD_D1,  INPUT);
  pinMode(LCD_D2,  INPUT);
  pinMode(LCD_D3,  INPUT);
  pinMode(LCD_D4,  INPUT);
  pinMode(LCD_D5,  INPUT);
  pinMode(LCD_D6,  INPUT);
  pinMode(LCD_D7,  INPUT);

  Port_RS->PIO_SODR = Mask_RS;	// RS = HIGH
  Port_CS->PIO_CODR = Mask_CS;	// CS = LOW
  lcd_read_data();                        // dummy read
  for(i=0; i<(x2-x1+1)*(y2-y1+1); i++){
    c1 = lcd_read_data();
    c2 = lcd_read_data();
    c3 = lcd_read_data();
    *buf++ = RGB(c3, c2, c1);
  }
  Port_CS->PIO_SODR = Mask_CS;	// CS = HIGH
  
  pinMode(LCD_D0,  OUTPUT);
  pinMode(LCD_D1,  OUTPUT);
  pinMode(LCD_D2,  OUTPUT);
  pinMode(LCD_D3,  OUTPUT);
  pinMode(LCD_D4,  OUTPUT);
  pinMode(LCD_D5,  OUTPUT);
  pinMode(LCD_D6,  OUTPUT);
  pinMode(LCD_D7,  OUTPUT);
}

void lcd_read_square(int x, int y, int w, int h, short *buf)
{
	lcd_read_mem(x, y, x+w-1, y+h-1, buf);
}
/********************************************************************************/
/*    lcd_write_data                              */
/********************************************************************************/
void lcd_write_data(int data)
{
	if(data&0x01) Port_D0->PIO_SODR=Mask_D0; else Port_D0->PIO_CODR=Mask_D0;
	if(data&0x02) Port_D1->PIO_SODR=Mask_D1; else Port_D1->PIO_CODR=Mask_D1;
	if(data&0x04) Port_D2->PIO_SODR=Mask_D2; else Port_D2->PIO_CODR=Mask_D2;
	if(data&0x08) Port_D3->PIO_SODR=Mask_D3; else Port_D3->PIO_CODR=Mask_D3;
	if(data&0x10) Port_D4->PIO_SODR=Mask_D4; else Port_D4->PIO_CODR=Mask_D4;
	if(data&0x20) Port_D5->PIO_SODR=Mask_D5; else Port_D5->PIO_CODR=Mask_D5;
	if(data&0x40) Port_D6->PIO_SODR=Mask_D6; else Port_D6->PIO_CODR=Mask_D6;
	if(data&0x80) Port_D7->PIO_SODR=Mask_D7; else Port_D7->PIO_CODR=Mask_D7;

	Port_RS->PIO_SODR = Mask_RS;	// RS = HIGH
	Port_CS->PIO_CODR = Mask_CS;	// CS = LOW
	Port_WR->PIO_CODR = Mask_WR;	// WR = LOW
	Port_WR->PIO_SODR = Mask_WR;	// WR = HIGH
	Port_CS->PIO_SODR = Mask_CS;	// CS = HIGH
}
/********************************************************************************/
/*    lcd_write_cmd                             */
/********************************************************************************/
void lcd_write_cmd(int data)
{
	if(data&0x01) Port_D0->PIO_SODR=Mask_D0; else Port_D0->PIO_CODR=Mask_D0;
	if(data&0x02) Port_D1->PIO_SODR=Mask_D1; else Port_D1->PIO_CODR=Mask_D1;
	if(data&0x04) Port_D2->PIO_SODR=Mask_D2; else Port_D2->PIO_CODR=Mask_D2;
	if(data&0x08) Port_D3->PIO_SODR=Mask_D3; else Port_D3->PIO_CODR=Mask_D3;
	if(data&0x10) Port_D4->PIO_SODR=Mask_D4; else Port_D4->PIO_CODR=Mask_D4;
	if(data&0x20) Port_D5->PIO_SODR=Mask_D5; else Port_D5->PIO_CODR=Mask_D5;
	if(data&0x40) Port_D6->PIO_SODR=Mask_D6; else Port_D6->PIO_CODR=Mask_D6;
	if(data&0x80) Port_D7->PIO_SODR=Mask_D7; else Port_D7->PIO_CODR=Mask_D7;

	Port_RS->PIO_CODR = Mask_RS;	// RS = LOW
	Port_CS->PIO_CODR = Mask_CS;	// CS = LOW
	Port_WR->PIO_CODR = Mask_WR;	// WR = LOW
	Port_WR->PIO_SODR = Mask_WR;	// WR = HIGH
	Port_CS->PIO_SODR = Mask_CS;	// CS = HIGH
}
/********************************************************************************/
/*    lcd_write_color                             */
/********************************************************************************/
void lcd_write_color(int color)
{
  lcd_write_data(color>>8);
  lcd_write_data(color);
}
/********************************************************************************/
/*		circle1																	*/
/*		(x0,y0) を中心に、半径 r の円を描く										*/
/********************************************************************************/
void circle1(int x0, int y0, int r, int color)
{
	int x,y,f;
	x=r;
	y=0;
	f=-2*r+3;
	while(x>=y){
		lcd_clear_square(x0-x, y0-y, 1,1, color);
		lcd_clear_square(x0-x, y0+y, 1,1, color);
		lcd_clear_square(x0+x, y0-y, 1,1, color);
		lcd_clear_square(x0+x, y0+y, 1,1, color);
		lcd_clear_square(x0-y, y0-x, 1,1, color);
		lcd_clear_square(x0-y, y0+x, 1,1, color);
		lcd_clear_square(x0+y, y0-x, 1,1, color);
		lcd_clear_square(x0+y, y0+x, 1,1, color);
		if(f>=0){
			x--;
			f-=x*4;
		}
		y++;
		f+=y*4+2;
	}
}
/********************************************************************************/
/*		circlefill																*/
/*		(x0,y0)を中心に、半径r、カラーcで塗られた円を描画						*/
/********************************************************************************/
void circlefill(int x0, int y0, int r, int c)
{
	int x,y,f;
	x=r;
	y=0;
	f=-2*r+3;
	while(x>=y){
		lcd_clear_square(x0-x, y0-y, 2*x+1, 1, c);
		lcd_clear_square(x0-x, y0+y, 2*x+1, 1, c);
		lcd_clear_square(x0-y, y0-x, 2*y+1, 1, c);
		lcd_clear_square(x0-y, y0+x, 2*y+1, 1, c);
		if(f>=0){
			x--;
			f-=x*4;
		}
		y++;
		f+=y*4+2;
	}
}
/********************************************************************************/
/*    chara_gene                                */
/*    12x16 ・ｽh・ｽb・ｽg・ｽL・ｽ・ｽ・ｽ・ｽ・ｽN・ｽ^・ｽ[・ｽl・ｽ・ｽ・ｽ[・ｽ^                    */
/********************************************************************************/
const short font[256][16]={
{0x000,0x000,0x000,0x000,0x000,0x000,0x000,0x000,0x000,0x000,0x000,0x000,0x000,0x000,0x000,0x000,}, // 0x00
{0x000,0x000,0x000,0x000,0x000,0x000,0x000,0x000,0x000,0x000,0x000,0x000,0x000,0x000,0x000,0x000,}, // 0x01
{0x000,0x000,0x000,0x000,0x000,0x000,0x000,0x000,0x000,0x000,0x000,0x000,0x000,0x000,0x000,0x000,}, // 0x02
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{0x000,0x000,0x000,0x000,0x000,0x000,0x000,0x000,0x000,0x000,0x000,0x000,0x000,0x000,0x000,0x000,}, // 0xff
};


const uint8_t KanjiFont12b[][18]={
{0x0,0x0,0x0,0x0,0x0,0x0,0x0,0x0,0x0,0x0,0x0,0x0,0x0,0x0,0x0,0x0,0x0,0x0},	// dummy data				code
{0x04,0x00,0x40,0x27,0xc2,0x40,0x24,0x0f,0xfe,0x24,0x84,0x44,0x0c,0x00,0x0c,0x07,0x07,0x80,},   // 歩	1
{0x00,0x07,0xfc,0x04,0x0f,0xfe,0x15,0x02,0x48,0xc4,0x43,0xfa,0x20,0x83,0xf8,0x20,0x83,0xf8,},   // 香	2
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{0x04,0x00,0x40,0xff,0xe1,0x10,0x11,0x0f,0xfe,0x24,0x83,0xf8,0x24,0x83,0xfa,0x04,0x20,0x7e,},   // 竜	14
};
